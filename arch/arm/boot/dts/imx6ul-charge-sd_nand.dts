/*
 * Copyright (C) 2017 charge Ltd. - http://www.charge.auto
 *
 * This program is free software; you can redistribute it and/or modify
 * it under the terms of the GNU General Public License version 2 as
 * published by the Free Software Foundation.
 */
/* SDCARD & NAND devices enabled eMMC & Wi-FI disabled.*/
/* #define WIFI */
/* #define EMMC */
#define  NAND
#include "imx6ul-charge.dtsi"

/*
 * Copyright (C) 2015 Freescale Semiconductor, Inc.
 *
 * Copyright (C) 2017 charge Ltd. - http://www.charge.auto
 *
 * This program is free software; you can redistribute it and/or modify
 * it under the terms of the GNU General Public License version 2 as
 * published by the Free Software Foundation.
 */
/* #define WIFI */
/* #define EMMC */
/* #define  NAND  */
/dts-v1/;

#include <dt-bindings/input/input.h>
#include "imx6ul.dtsi"
#include "imx6ul-imx6ull-charge-common.dtsi"

/ {
#ifdef NAND
#ifdef WIFI
	model = "Charge i.MX6 UltraLite NAND/WIFI";
#else
	model = "Charge i.MX6 UltraLite NAND/SD";
#endif
#endif
#ifdef EMMC
#ifdef WIFI
	model = "Charge i.MX6 UltraLite EMMC/WIFI";
#else
	model = "Charge i.MX6 UltraLite EMMC/SD";
#endif
#endif
	compatible = "fsl,imx6ul-charge", "fsl,imx6ul";
};

&iomuxc {
	pinctrl-names = "default";
	pinctrl-0 = <&pinctrl_hog_1
		     &pinctrl_hog_2>;
	imx6ul-evk {
		pinctrl_hog_2: hoggrp-2 {
			fsl,pins = <
				MX6UL_PAD_SNVS_TAMPER0__GPIO5_IO00	0x1b0b0
#ifdef WIFI
				MX6UL_PAD_SNVS_TAMPER5__GPIO5_IO05	0x1b0b0	/* BT Enable */
				MX6UL_PAD_ENET1_RX_ER__GPIO2_IO07	0x1b0b0 
				MX6UL_PAD_SNVS_TAMPER5__GPIO5_IO06	0x1b0b0/*0x03029	 WLAN enable */
#endif
			>;
		};
	};
};
